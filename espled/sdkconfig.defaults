## espled/sdkconfig.defaults
```kconfig
# Rust often needs a bit of an extra main task stack size compared to C (the default is 3K)
CONFIG_ESP_MAIN_TASK_STACK_SIZE=128000

# Use this to set FreeRTOS kernel tick frequency to 1000 Hz (100 Hz by default).
# This allows to use 1 ms granularity for thread sleeps (10 ms by default).
#CONFIG_FREERTOS_HZ=1000

# Workaround for https://github.com/espressif/esp-idf/issues/7631
#CONFIG_MBEDTLS_CERTIFICATE_BUNDLE=n
#CONFIG_MBEDTLS_CERTIFICATE_BUNDLE_DEFAULT_FULL=n

# USB-CDC config
CONFIG_ESP_CONSOLE_USB_SERIAL_JTAG=y
CONFIG_ESP_CONSOLE_UART_DEFAULT=n
CONFIG_VFS_SUPPORT_TERMIOS=y

# Allow verbose (Trace) logging from the Rust `esp-idf-svc` logger.
# Use the Kconfig option name rather than a raw numeric value so CMake/kconfig
# recognizes the selected choice when generating the final sdkconfig.
CONFIG_LOG_MAXIMUM_LEVEL_VERBOSE=y

# enable async drivers
CONFIG_SPI_MASTER_ISR_IN_IRAM=n
```
